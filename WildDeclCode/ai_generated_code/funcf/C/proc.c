```c
void scheduler(void)
{
  struct proc *p;
  struct cpu *c = mycpu();

  c->proc = 0;
  for (;;)
  {
    // Avoid deadlock by ensuring that devices can interrupt.
    intr_on();

    struct proc *process_with_highest_priority = 0;

    for (p = proc; p < &proc[NPROC]; p++)
    {
      acquire(&p->lock);
      if (p->state == RUNNABLE)
      {
        int RBI = 25;
        int tempRBI = 3 * p->RTime - p->STime - p->WTime;
        tempRBI = tempRBI * 50;
        int tempD = p->RTime + p->WTime + p->STime + 1;
        tempRBI = (int)tempRBI / tempD;
        if (tempRBI < 0)
        {
          tempRBI = 0;
        }
        RBI = tempRBI;
        int tempDP = p->SP + RBI;
        if (tempDP > 100)
        {
          tempDP = 100;
        }
        p->DP = tempDP;

        // struct proc *init = process_with_highest_priority;

        if (process_with_highest_priority == 0)
        {
          process_with_highest_priority = p;
        }
        else if (process_with_highest_priority->DP > p->DP)
        {
          process_with_highest_priority = p;
        } // Above code block Aided with basic GitHub coding tools (no prompt given for this one, understood context of code on its own)
        else if (process_with_highest_priority->DP == p->DP)
        {
          if (process_with_highest_priority->scheduled > p->scheduled)
          {
            process_with_highest_priority = p;
          } // Above code block Aided with basic GitHub coding tools after if condition was specified
          else if (process_with_highest_priority->scheduled == p->scheduled)
          {
            if (process_with_highest_priority->ctime > p->ctime)
            {
              process_with_highest_priority = p;
            } // Above code block generated by coplit after else if condition was specified
          }
        }

        // if (init != process_with_highest_priority)
        // {

        //   if (p->pid >= 3)
        //   {
        //     printf("PID : %d, Priority : %d\n", p->pid, p->DP);
        //   }
        // }
        // Switch to chosen process.  It is the process's job
        // to release its lock and then reacquire it
        // before jumping back to us.

        // Process is done running for now.
        // It should have changed its p->state before coming back.
        // c->proc = 0;
      }
      release(&p->lock);
    }

    if (process_with_highest_priority)
    {
      acquire(&process_with_highest_priority->lock);
      // p->state = RUNNING;
      // c->proc = p;
      // swtch(&c->context, &p->context);
      if (process_with_highest_priority->state == RUNNABLE)
      {
        process_with_highest_priority->state = RUNNING;
        process_with_highest_priority->scheduled++;
        c->proc = process_with_highest_priority;
        swtch(&c->context, &process_with_highest_priority->context);
        c->proc = 0;
        // Above code block partially Aided with basic GitHub coding tools (wrote first 2 lines only)
      }
      release(&process_with_highest_priority->lock);
    }
  }
}
```